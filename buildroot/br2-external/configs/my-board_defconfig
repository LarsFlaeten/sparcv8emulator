## buildroot/br2-external/configs/my-board_defconfig
```kconfig
BR2_ROOTFS_OVERLAY="$(BR2_EXTERNAL_PROJECT_EXAMPLE_PATH)/board/my-board/overlay/"
BR2_ROOTFS_POST_BUILD_SCRIPT="$(BR2_EXTERNAL_PROJECT_EXAMPLE_PATH)/board/my-board/post-build.sh"
BR2_ROOTFS_DEVICE_TABLE="system/device_table.txt $(BR2_EXTERNAL_PROJECT_EXAMPLE_PATH)/board/my-board/device_table.txt"
BR2_ROOTFS_USERS_TABLES="$(BR2_EXTERNAL_PROJECT_EXAMPLE_PATH)/board/my-board/user_table.txt"
BR2_LINUX_KERNEL_CONFIG_FRAGMENT_FILES="$(BR2_EXTERNAL_PROJECT_EXAMPLE_PATH)/board/my-board/kernel.config"
BR2_PACKAGE_BUSYBOX_CONFIG_FRAGMENT_FILES="$(BR2_EXTERNAL_PROJECT_EXAMPLE_PATH)/board/my-board/busybox.config"
BR2_PACKAGE_KBD=y
```
